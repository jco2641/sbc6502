      .import VIA1_PORTB
      .import VIA1_PORTA
      .import VIA1_DDRB
      .import VIA1_DDRA
      .import VIA1_T1CL
      .import VIA1_T1CH
      .import VIA1_T1LL
      .import VIA1_T1LH
      .import VIA1_T2CL
      .import VIA1_T2CH
      .import VIA1_SR
      .import VIA1_ACR
      .import VIA1_PCR
      .import VIA1_IFR
      .import VIA1_IER
      .import VIA1_PANH

      .import VIA2_PORTB
      .import VIA2_PORTA
      .import VIA2_DDRB
      .import VIA2_DDRA
      .import VIA2_T1CL
      .import VIA2_T1CH
      .import VIA2_T1LL
      .import VIA2_T1LH
      .import VIA2_T2CL
      .import VIA2_T2CH
      .import VIA2_SR
      .import VIA2_ACR
      .import VIA2_PCR
      .import VIA2_IFR
      .import VIA2_IER
      .import VIA2_PANH

      .import VIA3_PORTB
      .import VIA3_PORTA
      .import VIA3_DDRB
      .import VIA3_DDRA
      .import VIA3_T1CL
      .import VIA3_T1CH
      .import VIA3_T1LL
      .import VIA3_T1LH
      .import VIA3_T2CL
      .import VIA3_T2CH
      .import VIA3_SR
      .import VIA3_ACR
      .import VIA3_PCR
      .import VIA3_IFR
      .import VIA3_IER
      .import VIA3_PANH

      .import VIA4_PORTB
      .import VIA4_PORTA
      .import VIA4_DDRB
      .import VIA4_DDRA
      .import VIA4_T1CL
      .import VIA4_T1CH
      .import VIA4_T1LL
      .import VIA4_T1LH
      .import VIA4_T2CL
      .import VIA4_T2CH
      .import VIA4_SR
      .import VIA4_ACR
      .import VIA4_PCR
      .import VIA4_IFR
      .import VIA4_IER
      .import VIA4_PANH
